/* Copyright (c) 2016, Motorola Mobility Inc. All rights reserved.
 *
 * This program is free software; you can redistribute it and/or modify
 * it under the terms of the GNU General Public License version 2 and
 * only version 2 as published by the Free Software Foundation.
 *
 * This program is distributed in the hope that it will be useful,
 * but WITHOUT ANY WARRANTY; without even the implied warranty of
 * MERCHANTABILITY or FITNESS FOR A PARTICULAR PURPOSE.  See the
 * GNU General Public License for more details.
 */

/ {
	aliases {
		i2c1 = &i2c_1;
		i2c2 = &i2c_2;
		i2c3 = &i2c_3;
		i2c4 = &i2c_4;
		spi1 = &spi_1;
		spi6 = &spi_6;
		spi8 = &spi_8;
		uart5 = &blsp2_uart1;
		/delete-property/ spi3;
		/delete-property/ i2c5;
	};

	reserved-memory {
		ramoops_mem: ramoops_mem_region {
			no-map;
			reg = <0x0 0xef000000 0x0 0xC0000>;
			label = "ramoops_mem";
		};
		tzlog_bck_mem: tzlog_bck_region {
			no-map;
			reg = <0x0 TZLOG_BCK_BASE_8953
				0x0 TZLOG_BCK_SIZE>;
			label = "tzlog_bck_mem";
		};

		wdog_cpuctx_mem: wdog_cpuctx_region {
			no-map;
			reg = <0x0 WDOG_CPUCTX_BASE_8953
				0x0 WDOG_CPUCTX_SIZE_8953>;
			label = "wdog_cpuctx_mem";
		};
	};

	utags {
		compatible = "mmi,utags";
		mmi,main-utags = "/dev/block/bootdevice/by-name/utags";
		mmi,backup-utags = "/dev/block/bootdevice/by-name/utagsBackup";
	};

	hw {
		compatible = "mmi,utags";
		mmi,dir-name = "hw";
		mmi,main-utags = "/dev/block/bootdevice/by-name/hw";
	};

};

&soc{
	/delete-node/ uart@78b0000;
	/delete-node/ uart@7aef000;
	/delete-node/ i2c@7af5000;
	/delete-node/ spi@78b7000;
	/delete-node/ adv_vreg;
	/delete-node/ sound-9335;

	alsa_to_h2w {
		compatible = "mmi,alsa-to-h2w";
	};

	dummy_vreg: dummy_vreg {
		compatible = "regulator-fixed";
		status = "ok";
		regulator-name = "dummy_vreg";
		regulator-always-on;
	};

	i2c_2: i2c@78b6000 { /* BLSP1 QUP2 */
		compatible = "qcom,i2c-msm-v2";
		#address-cells = <1>;
		#size-cells = <0>;
		reg-names = "qup_phys_addr";
		reg = <0x78b6000 0x1000>;
		interrupt-names = "qup_irq";
		interrupts = <0 96 0>;
		qcom,clk-freq-out = <400000>;
		qcom,clk-freq-in  = <19200000>;
		clock-names = "iface_clk", "core_clk";
		clocks = <&clock_gcc clk_gcc_blsp1_ahb_clk>,
			<&clock_gcc clk_gcc_blsp1_qup2_i2c_apps_clk>;

		pinctrl-names = "i2c_active", "i2c_sleep";
		pinctrl-0 = <&i2c_2_active>;
		pinctrl-1 = <&i2c_2_sleep>;
		qcom,noise-rjct-scl = <0>;
		qcom,noise-rjct-sda = <0>;
		qcom,master-id = <86>;
		dmas = <&dma_blsp1 6 64 0x20000020 0x20>,
			<&dma_blsp1 7 32 0x20000020 0x20>;
		dma-names = "tx", "rx";
		cs35l34@40 {
			compatible = "cirrus,cs35l34";
			reg = <0x40>;

			cirrus,gain-zc = <1>;
			pinctrl-names = "default";
			pinctrl-0 = <&cs35l34_reset_default>;
		};

		fusb302@22 {
			compatible = "fairchild,fusb302";
			reg = <0x22>;
			gpios = <&tlmm 67 1>; /* FUSB302_INT_N, in */
			fusb,gpio-labels = "gpio_fusb_int_n";
			pinctrl-names = "default", "active";
			pinctrl-0 = <&fusb302_int_default>;
			pinctrl-1 = <&fusb302_int_active>;
		};

		/delete-node/ adv7533@39;

		usb3813@2D {
			compatible = "microchip,usb3813";
			reg = <0x2D>;
			pinctrl-0 = <&hub_reset_n_default &hub_int_n_default>;
			pinctrl-names = "default";
			gpios = <&tlmm 74 0x20>,   /* HUB_RESET_EN */
				<&tlmm 48 1>;   /* HUB_INT_N */
			gpio-labels = "gpio_hub_reset_n",
				"gpio_hub_int_n";
			clock-names = "hub_clk";
			clocks = <&clock_gcc clk_bb_clk2>;
			switch-usbhost;
			vdd-hsic-supply = <&pm8953_l23>;
		};
	};

	i2c_3: i2c@78b7000 { /* BLSP1 QUP3 */
		status = "okay";
		compatible = "qcom,i2c-msm-v2";
		#address-cells = <1>;
		#size-cells = <0>;
		reg-names = "qup_phys_addr";
		reg = <0x78b7000 0x600>;
		interrupt-names = "qup_irq";
		interrupts = <0 97 0>;
		qcom,clk-freq-out = <400000>;
		qcom,clk-freq-in  = <19200000>;
		clock-names = "iface_clk", "core_clk";
		clocks = <&clock_gcc clk_gcc_blsp1_ahb_clk>,
			<&clock_gcc clk_gcc_blsp1_qup3_i2c_apps_clk>;

		pinctrl-names = "i2c_active", "i2c_sleep";
		pinctrl-0 = <&i2c_3_active>;
		pinctrl-1 = <&i2c_3_sleep>;
		qcom,noise-rjct-scl = <0>;
		qcom,noise-rjct-sda = <0>;
		qcom,master-id = <86>;
		dmas = <&dma_blsp1 8 64 0x20000020 0x20>,
			<&dma_blsp1 9 32 0x20000020 0x20>;
		dma-names = "tx", "rx";
		synaptics_dsx_i2c@20 {
			compatible = "synaptics,synaptics_dsx_i2c";
			reg = <0x20>;
			interrupt-parent = <&tlmm>;
			interrupts = <65 0x2008>;
			gpios = <&tlmm 65 0x2008>, /* IRQ */
				<&tlmm 64 0>; /* RESET */
			synaptics,gpio-config;
			pinctrl-names = "default", "active";
			pinctrl-0 = <&touch_reset_default &touch_int_default>;
			pinctrl-1 = <&touch_reset_active &touch_int_active>;
			config_modifier-names = "aod", "fps";
			config_modifier-aod {
				aod-suspended {
					/* Power->sleep; */
					patch-data = "S";
				};
			};
			config_modifier-fps {
				enable-notification;
				fps-active {
					touch-clip-area = <400 1870 700 1919 1>;
				};
			};
		};

	};

	/* SensorHub Bus */
	i2c_4: i2c@78b8000 {
		/* BLSP1 QUP4, however QC refers to this address as:
		   HWID BLSP4 - BLSP1 QUP3
		*/
		status = "okay";
		compatible = "qcom,i2c-msm-v2";
		#address-cells = <1>;
		#size-cells = <0>;
		reg-names = "qup_phys_addr";
		reg = <0x78b8000 0x600>;
		interrupt-names = "qup_irq";
		interrupts = <0 98 0>;
		dmas = <&dma_blsp1 10 64 0x20000020 0x20>,
			<&dma_blsp1 11 32 0x20000020 0x20>;
		dma-names = "tx", "rx";
		qcom,master-id = <86>;
		qcom,clk-freq-out = <400000>;
		qcom,clk-freq-in  = <19200000>;
		clock-names = "iface_clk", "core_clk";
		clocks = <&clock_gcc clk_gcc_blsp1_ahb_clk>,
			 <&clock_gcc clk_gcc_blsp1_qup4_i2c_apps_clk>;
		pinctrl-names = "i2c_active", "i2c_sleep";
		pinctrl-0 = <&i2c_4_active>;
		pinctrl-1 = <&i2c_4_sleep>;
	};

	spi_6: spi@7af6000 { /* BLSP2 QUP2 */
		status = "ok";
		compatible = "qcom,spi-qup-v2";
		#address-cells = <1>;
		#size-cells = <0>;
		reg-names = "spi_physical", "spi_bam_physical";
		reg = <0x07af6000 0x600>,
		<0x07ac4000 0x1f000>;
		interrupt-names = "spi_irq", "spi_bam_irq";
		interrupts = <0 300 0>, <0 239 0>;
		spi-max-frequency = <19200000>;

		qcom,infinite-mode = <0>;
		qcom,use-bam;
		qcom,ver-reg-exists;
		qcom,bam-consumer-pipe-index = <6>;
		qcom,bam-producer-pipe-index = <7>;
		qcom,master-id = <84>;
		qcom,use-pinctrl;
		pinctrl-names = "spi_default", "spi_sleep";
		pinctrl-0 = <&spi_6_active &spi6_cs0_active>;
		pinctrl-1 = <&spi_6_sleep &spi6_cs0_sleep>;

		clock-names = "iface_clk", "core_clk";

		clocks = <&clock_gcc clk_gcc_blsp2_ahb_clk>,
			<&clock_gcc clk_gcc_blsp2_qup2_spi_apps_clk>;
		};
			adsps {
				#address-cells = <1>;
				#size-cells = <0>;
				adsp@0ffe00 {
					reg = <0x0ffe00>;
					firmware {
						ultrasound {
							wlf,wmfw-file = "ultrasound";
							wlf,bin-file = "ultrasound";
							wlf,compr-caps = <1 1 4 1 96000>;
						};
					};
				};
				adsp@17fe00 {
					reg = <0x17fe00>;
					firmware {
						frontend {
							wlf,wmfw-file = "aov-frontend";
							wlf,bin-file = "aov-vrgain";
							wlf,compr-caps = <1 1 4 1 16000>;
						};
					};
				};
				adsp@1ffe00 {
					reg = <0x1ffe00>;
					firmware {
						aov {
							wlf,wmfw-file = "aov-control";
							wlf,bin-file = "aov-model";
							wlf,compr-caps = <1 1 4 1 16000>;
						};
					};
				};
			};
		};
	};

	spi_8: spi@7af8000 { /* BLSP2 QUP3 */
		compatible = "qcom,spi-qup-v2";
		status = "ok";
		#address-cells = <1>;
		#size-cells = <0>;
		reg-names = "spi_physical";
		reg = <0x07af8000 0x600>;
		interrupt-names = "spi_irq";
		interrupts = <0 302 0>;
		spi-max-frequency = <19200000>;

		pinctrl-names = "spi_default", "spi_sleep";
		pinctrl-0 = <&spi_8_active>;
		pinctrl-1 = <&spi_8_sleep>;
		qcom,infinite-mode = <0>;
		qcom,master-id = <84>;
		qcom,use-pinctrl;

	blsp2_uart1: uart@7aef000 { /* BLSP2 UART1 */
		compatible = "qcom,msm-hsuart-v14";
		reg = <0x7aef000 0x200>,
			<0x7ac4000 0x1f000>;
		reg-names = "core_mem", "bam_mem";

		interrupt-names = "core_irq", "bam_irq", "wakeup_irq";
		#address-cells = <0>;
		interrupt-parent = <&blsp2_uart1>;
		interrupts = <0 1 2>;
		#interrupt-cells = <1>;
		interrupt-map-mask = <0xffffffff>;
		interrupt-map = <0 &intc 0 306 0
				1 &intc 0 239 0
				2 &tlmm 17 0>;

		qcom,tx-gpio = <&tlmm 16 0>;
		qcom,rx-gpio = <&tlmm 17 1>;
		qcom,cts-gpio = <&tlmm 18 0>;
		qcom,rts-gpio = <&tlmm 19 1>;
		qcom,master-id = <84>;
		clock-names = "core_clk", "iface_clk";
		clocks = <&clock_gcc clk_gcc_blsp2_uart1_apps_clk>,
			<&clock_gcc clk_gcc_blsp2_ahb_clk>;
		qcom,bam-tx-ep-pipe-index = <0>;
		qcom,bam-rx-ep-pipe-index = <1>;
		qcom,msm-bus,name = "blsp2_uart1";
		qcom,msm-bus,num-cases = <2>;
		qcom,msm-bus,num-paths = <1>;
		qcom,msm-bus,vectors-KBps =
				<84 512 0 0>,
				<84 512 500 800>;
		status = "ok";
	};

	usb3: ssusb@7000000{
		mmi,qos_latency = <10999>;
		vbus_dwc3-supply = <&usb_otg_switch>;
		pinctrl-names = "default";
		pinctrl-0 = <&otg_en_default &otg_fault_default>;
		qcom,otg-fault-gpio = <&tlmm 34  0x1>; /* GPIOF_IN*/
		psy,type-c;
		qcom,ssusb-compliance;
		dwc3@7000000 {
			controller-number = /bits/ 8 <1>;
		};
	};

	sound {
		status = "ok";
		compatible = "qcom,msm8952-audio-slim-codec";
		qcom,model = "msm8952-marley-card";

		/* qcom,marley-mclk-clk-freq = <9600000>; */
		asoc-platform = <&pcm0>, <&pcm1>, <&pcm2>, <&voip>, <&voice>,
			<&loopback>, <&compress>, <&hostless>,
			<&afe>, <&lsm>, <&routing>, <&cpe>, <&lpa>, <&marley>;
		asoc-platform-names = "msm-pcm-dsp.0", "msm-pcm-dsp.1",
			"msm-pcm-dsp.2", "msm-voip-dsp",
			"msm-pcm-voice", "msm-pcm-loopback",
			"msm-compress-dsp", "msm-pcm-hostless",
			"msm-pcm-afe", "msm-lsm-client",
			"msm-pcm-routing", "msm-cpe-lsm",
			"msm-pcm-lpa", "marley-codec";
		asoc-cpu = <&dai_pri_auxpcm>, <&dai_mi2s3>, <&dai_mi2s5>,
			<&sb_0_rx>, <&sb_0_tx>, <&sb_1_rx>, <&sb_1_tx>,
			<&sb_2_rx>, <&sb_2_tx>, <&sb_3_rx>, <&sb_3_tx>,
			<&sb_4_rx>, <&sb_4_tx>, <&sb_5_tx>,
			<&afe_pcm_rx>, <&afe_pcm_tx>,
			<&afe_proxy_rx>, <&afe_proxy_tx>,
			<&incall_record_rx>, <&incall_record_tx>,
			<&incall_music_rx>, <&incall_music_2_rx>,
			<&sb_5_rx>, <&bt_sco_rx>, <&bt_sco_tx>,
			<&int_fm_rx>, <&int_fm_tx>;
		asoc-cpu-names = "msm-dai-q6-auxpcm.1",
			"msm-dai-q6-mi2s.3", "msm-dai-q6-mi2s.5",
			"msm-dai-q6-dev.16384", "msm-dai-q6-dev.16385",
			"msm-dai-q6-dev.16386", "msm-dai-q6-dev.16387",
			"msm-dai-q6-dev.16388", "msm-dai-q6-dev.16389",
			"msm-dai-q6-dev.16390", "msm-dai-q6-dev.16391",
			"msm-dai-q6-dev.16392", "msm-dai-q6-dev.16393",
			"msm-dai-q6-dev.16395", "msm-dai-q6-dev.224",
			"msm-dai-q6-dev.225", "msm-dai-q6-dev.241",
			"msm-dai-q6-dev.240", "msm-dai-q6-dev.32771",
			"msm-dai-q6-dev.32772", "msm-dai-q6-dev.32773",
			"msm-dai-q6-dev.32770", "msm-dai-q6-dev.16394",
			"msm-dai-q6-dev.12288", "msm-dai-q6-dev.12289",
			"msm-dai-q6-dev.12292", "msm-dai-q6-dev.12293";
		asoc-codec = <&stub_codec>;
		asoc-codec-names = "msm-stub-codec.1";
	};

	qcom,msm-dai-mi2s {
		dai_mi2s0: qcom,msm-dai-q6-mi2s-prim {
			status = "disabled";
		};
		dai_mi2s1: qcom,msm-dai-q6-mi2s-sec {
			status = "disabled";
		};
		dai_mi2s2: qcom,msm-dai-q6-mi2s-tert {
			status = "disabled";
		};
		dai_mi2s3: qcom,msm-dai-q6-mi2s-quat {
			pinctrl-names = "default", "idle";
			pinctrl-0 = <&sec_tlmm_lines_act>;
			pinctrl-1 = <&sec_tlmm_lines_sus>;
		};
		dai_mi2s5: qcom,msm-dai-q6-mi2s-quin {
			qcom,msm-mi2s-rx-lines = <2>;
			pinctrl-names = "default", "idle";
			pinctrl-0 = <&pri_tlmm_lines_act>, <&pri_tlmm_ws_act>;
			pinctrl-1 = <&pri_tlmm_lines_sus>, <&pri_tlmm_ws_sus>;
		};
		dai_mi2s6: qcom,msm-dai-q6-mi2s-senary {
			status = "disabled";
		};
	};

	qcom,sensor-information {
		sensor_information18: qcom,sensor-information-18 {
			qcom,sensor-type = "adc";
			qcom,sensor-name = "chg_therm";
		};

		sensor_information21: qcom,sensor-information-21 {
			qcom,sensor-type = "adc";
			qcom,sensor-name = "msm_therm";
		};

		sensor_information22: qcom,sensor-information-22 {
			qcom,sensor-type = "adc";
			qcom,sensor-name = "battery";
			qcom,alias-name  = "batt_therm";
			qcom,scaling-factor = <1000>;
		};
		sensor_information23: qcom,sensor-information-23 {
			qcom,sensor-type = "adc";
			qcom,sensor-name = "front_temp";
			qcom,scaling-factor = <1000>;
		};
		sensor_information24: qcom,sensor-information-24 {
			qcom,sensor-type = "adc";
			qcom,sensor-name = "back_temp";
			qcom,scaling-factor = <1000>;
		};
	};

	ramoops {
		compatible = "ramoops";
		status = "ok";

		android,ramoops-buffer-start = <0xef000000>;
		android,ramoops-buffer-size = <0xC0000>;
		android,ramoops-console-size = <0x40000>;
		android,ramoops-pmsg-size = <0x40000>;
		android,ramoops-record-size = <0x3F800>;
		android,ramoops-annotate-size = <0x800>;
		android,ramoops-dump-oops = <0x1>;

		linux,contiguous-region = <&ramoops_mem>;
	};

	wdog: qcom,wdt@b017000 {
		qcom,bark-time = <22000>;
		linux,contiguous-region = <&wdog_cpuctx_mem>;
	};

	qcom_tzlog: tz-log@08600720 {
		status = "okay";
		linux,contiguous-region = <&tzlog_bck_mem>;
	};

	fsusb42 {
		compatible = "fairchild,fsusb42";
		gpios = <&pm8953_gpios 6 0>; /* USB_SELECT, output-low */
		gpio-names = "gpio_fsusb_select";
		vdd-fsusb42-supply = <&pm8953_l13>;
		status = "okay";
	};

	hd3ss460 {
		compatible = "ti,hd3ss460";
		pinctrl-names = "default", "active";
		pinctrl-0 = <&hd3ss460_amsel_default>;
		pinctrl-1 = <&hd3ss460_amsel_active>;
		gpios = <&pm8953_gpios 7 0>, /* USB_SS_MOD_EN, output-low */
			<&tlmm 130 0>,       	 /* USB_SS_SW_SEL, output-low */
			<&pm8953_gpios 8 0>; /* USB_SS_MOD_MPHY_AP_EN, output-low */
		hd3-gpio-labels = "gpio_hd3ss460_pol",
				"gpio_hd3ss460_amsel",
				"gpio_hd3ss460_en";
		vdd-hd3ss460-supply = <&pm8953_l6>;
		vdd-voltage-level = <1800000 1800000>;
		vdd-current-level = <200 30000>;
	};

	qusb_phy: qusb@79000 {
		qcom,qusb-phy-init-seq = <0x73 0x80
					0x72 0x84
					0x07 0x88
					0x13 0x8C
					0x30 0x08
					0x79 0x0C
					0x21 0x10
					0x14 0x9C
					0x9F 0x1C
					0x00 0x18>;
	};

	usb_otg_switch: usb-otg-switch {
		compatible = "regulator-fixed";
		regulator-name = "usb_otg_vreg";
		vin-supply = <&smbcharger_external_otg>;
		enable-active-high;
		gpio = <&tlmm 109 0>;
		status = "okay";
	};

	sys_temp_support {
		compatible = "mmi,sys-temp";
		mmi,temperature-names = "front_temp",
					"back_temp";
		status = "ok";
	};
};

&pmi8950_mpps {
	mpp@a000 { /* MPP1 MOD_MPHY_I2S_EN */
		qcom,mode = <1>;	/* Digital output */
		qcom,vin-sel = <2>;	/* 1.8 */
		qcom,src-sel = <0>;	/* GPIO */
		qcom,master-en = <1>;	/* Enable GPIO */
		qcom,invert = <0>;	/* Output low (disabled) */
		status = "okay";
	};

	mpp@a100 { /* MPP2 MOD_MPHY_I2S_SEL */
		qcom,mode = <1>;	/* Digital output */
		qcom,vin-sel = <2>;	/* 1.8 */
		qcom,src-sel = <0>;	/* GPIO */
		qcom,master-en = <1>;	/* Enable GPIO */
		qcom,invert = <1>;	/* Output high */
		status = "okay";
	};

	mpp@a300 { /* MPP4 MOD_BPLUS_FAULT_N */
		qcom,mode = <0>;	/* Digital input */
		qcom,vin-sel = <2>;	/* 1.8 */
		qcom,src-sel = <0>;	/* GPIO */
		qcom,master-en = <1>;	/* Enable GPIO */
		status = "okay";
	};
};

&pmi_haptic{
	qcom,actuator-type = "lra";
	qcom,lra-auto-res-mode="none";
	qcom,wave-shape = "sine";
	qcom,lra-high-z="opt1";
	qcom,lra-res-cal-period = <4>;
	/* period below corresponds to 175 Hz */
	qcom,wave-play-rate-us = <5714>;
	qcom,vmax-mv = <2900>;
	qcom,vmax-low-mv = <1160>;
	qcom,context-haptics;
	qcom,brake-pattern = [03 03 02 00];
	qcom,misc-trim-error-rc19p2-clk-reg-present;
};

&blsp1_uart0 {
	status = "ok";
	pinctrl-names = "default";
	pinctrl-0 = <&uart_console_active>;
};

&pmi8950_gpios {
	gpio@c000 { /* GPIO 1 - MOD_BPLUS_EN */
		qcom,mode = <1>;	/* Digital output */
		qcom,pull = <5>;	/* No Pull */
		qcom,vin-sel = <0>;	/* 1.8 */
		qcom,src-sel = <0>;	/* GPIO */
		qcom,master-en = <1>;	/* Enable GPIO */
		qcom,invert = <0>;	/* Output Low */
		status = "okay";
	};

	gpio@c100 {
		qcom,mode = <1>;	/* Digital output */
		qcom,pull = <5>;	/* No Pull */
		qcom,vin-sel = <0>;	/* 1.8 */
		qcom,src-sel = <0>;	/* GPIO */
		qcom,master-en = <1>;	/* Enable GPIO */
		qcom,invert = <0>;	/* Output Low */
		status = "okay";
	};
};

&pmi8950_mpps {
	mpp@a000 { /* MPP 1 - MOD_F_FLASH */
		qcom,mode = <1>;	/* Digital output */
		qcom,vin-sel = <2>;	/* 1.8 */
		qcom,src-sel = <0>;	/* GPIO */
		qcom,master-en = <1>;	/* Enable GPIO */
		qcom,invert = <0>;	/* Output low */
		status = "okay";
	};
};

&pm8953_gpios {
	gpio@c100 {
		status = "okay";
		qcom,mode = <1>; /* Digital output */
		qcom,output-type = <0>; /* CMOS logic */
		qcom,pull = <5>; /* From QC */
		qcom,invert = <0>; /* Output low initially */
		qcom,vin-sel = <3>; /* VIN 3 */
		qcom,src-sel = <0x6>; /* DTEST3 */
		qcom,out-strength = <2>; /* Medium */
		qcom,master-en = <1>; /* Enable GPIO */
		reg = <0xc100 0x100>;
		qcom,pin-num = <2>;
	};

	gpio@c400 {
		qcom,mode = <0>;		/* Digital Input */
		qcom,pull = <5>;		/* No pull  */
		qcom,vin-sel = <2>;		/* VIN0 */
		qcom,src-sel = <0>;		/* GPIO */
		qcom,out-strength = <2>;        /* Medium */
		qcom,master-en = <1>;		/* Enable GPIO */
		status = "okay";
	};

	gpio@c500 { /* GPIO 6 - USB_SELECT */
		qcom,mode = <1>;		/* Digital Output */
		qcom,pull = <5>;		/* No pull  */
		qcom,vin-sel = <2>;		/* VIN0 */
		qcom,src-sel = <0>;		/* GPIO */
		qcom,out-strength = <2>;        /* Medium */
		qcom,master-en = <1>;		/* Enable GPIO */
		status = "okay";
	};

	gpio@c600 { /* GPIO 7 - USB_SS_MOD_EN */
		qcom,mode = <1>;		/* Digital Output */
		qcom,pull = <5>;		/* No pull  */
		qcom,vin-sel = <2>;		/* VIN0 */
		qcom,src-sel = <0>;		/* GPIO */
		qcom,out-strength = <2>;        /* Medium */
		qcom,master-en = <1>;		/* Enable GPIO */
		status = "okay";
	};

	gpio@c700 { /* GPIO 8 - USB_SS_MOD_MPHY_AP_EN */
		qcom,mode = <1>;		/* Digital Output */
		qcom,pull = <5>;		/* No pull  */
		qcom,vin-sel = <2>;		/* VIN0 */
		qcom,src-sel = <0>;		/* GPIO */
		qcom,out-strength = <2>;        /* Medium */
		qcom,master-en = <1>;		/* Enable GPIO */
		status = "okay";
	};
};

&pmi8950_charger {
	status = "okay";
	pinctrl-names = "default";
	pinctrl-0 = <&factory_default>;
	gpios = <&pmi8950_gpios 2 0x0>, /* GPIOF_OUT_INIT_LOW */
		<&pm8953_gpios 5 0x1>, /* GPIOF_IN */
		<&tlmm 110 0x0>; /* GPIOF_OUT_INIT_LOW */
	gpio-names = "eb_vbus_en",
		     "factory_warn",
		     "togl_rst";
	/delete-property/ qcom,iterm-ma;
	qcom,iterm-disabled;
	/delete-property/ qcom,autoadjust-vfloat;
	/delete-property/ qcom,dc-psy-type;
	qcom,dc-psy-ma = <900>;
	qcom,dc-psy-eff-ma = <500>;
	qcom,fastchg-current-ma = <3000>;
	qcom,max-usbin-current-ma = <2600>;
	qcom,float-voltage-mv = <4400>;
	qcom,resume-delta-mv = <200>;
	qcom,chg-inhibit-fg;
	qcom,rparasitic-uohm = <100000>;
	qcom,bms-psy-name = "bms";
	qcom,eb-batt-psy-name = "gb_battery";
	qcom,eb-pwr-psy-name = "gb_ptp";
	qcom,charge-unknown-battery;
	qcom,chg-thermal-mitigation = <3000 0>,
				      <2500 0>,
				      <2000 0>,
				      <1500 0>,
				      <1000 0>,
				      <500 0>;
	qcom,dc-thermal-mitigation = <2000>,
				     <1500>,
				     <900>,
				     <600>,
				     <300>;
	qcom,thermal-mitigation = <3000 0>,
				  <2500 0>,
				  <2000 0>,
				  <1500 0>,
				  <1000 0>,
				  <500 0>,
				  <300 0>;
	qcom,step-chg-steps = <4200 3000 2400>,
				<4400 2400 2000>;
	qcom,stepchg-iterm-ma = <170>;
	qcom,hot-temp-c = <60>;
	qcom,cold-temp-c = <(-20)>;
	qcom,warm-temp-c = <45>;
	qcom,cool-temp-c = <0>;
	qcom,ext-temp-volt-mv = <4200>;
	qcom,hotspot-thrs-c = <50>;
	qcom,charging-timeout-mins = <0>;
	qcom,precharging-timeout-mins = <0>;
	qcom,bmd-algo-disabled;
	qcom,bmd-pin-src = "bpd_none";
	qcom,usbid-disabled;
	qcom,force-aicl-rerun;
	mmi,fake-factory-type;
	qcom,auto-voltage-comp-mv = <75>;
	qcom,usbin-vadc = <&pmi8950_vadc>;
	qcom,dcin-vadc = <&pmi8950_vadc>;

	smbcharger_external_otg: qcom,smbcharger-external-otg {
		status = "okay";
		regulator-name = "smbcharger_external_otg";
	};
};

&pmi8950_fg {
	status = "okay";
	qcom,warm-bat-decidegc = <450>;
	qcom,cool-bat-decidegc = <0>;
	qcom,hot-bat-decidegc = <600>;
	qcom,cold-bat-decidegc = <(-200)>;
	qcom,thermal-coefficients =  /bits/ 16 <0x6986 0x5D4B 0x6235>;
	qcom,resume-soc = <99>;
	qcom,bcl-lm-threshold-ma = <126>;
	qcom,bcl-mh-threshold-ma = <400>;
	qcom,fg-iterm-ma = <150>;
	qcom,irq-volt-empty-mv = <2750>;
	qcom,fg-cutoff-voltage-mv = <3000>;
	qcom,fg-vbat-estimate-diff-mv = <1000>;
	qcom,fg-delta-soc = <1>;
	qcom,fg-max-soc = <100>;
	qcom,fg-min-soc = <0>;
	qcom,fg-cc-cv-threshold-mv = <4390>;
	/delete-property/ qcom,capacity-learning-feedback;
	qcom,battery-data = <&mot_batterydata>;
};

&spmi_bus {
	qcom,pmi8950@2 {
		qcom,power-on@800 {
			qcom,shipmode;
		};
	};
};

&pm8953_typec {
	status = "disabled";
};

&mdss_dsi_active {
	config {
		/delete-property/ output-high;
	};
};

&mdss_mdp {
	qcom,mdss-pref-prim-intf = "dsi";
};

&mdss_dsi0 {
	qcom,display-id = "primary";
};

&pm8953_vadc {
	chan@11 {
		label = "chg_therm";
	};

	chan@13 {
		label = "msm_therm";
	};
};

&pmi8950_vadc {
	/delete-node/ chan@d;
};

&other_ext_mem {
	reg = <0x0 0x84300000 0x0 0x2500000>;
};

&qcom_seecom {
	reg = <0x84300000 0x2000000>;
};

&pm8953_l23 {
	qcom,init-voltage = <1200000>;
};

&rpm_bus {
	rpm-regulator-ldoa22 {
	pm8950_l22: regulator-l22 {
			regulator-min-microvolt = <2850000>;
			regulator-max-microvolt = <2850000>;
			qcom,init-voltage = <2850000>;
		};
	};
};
